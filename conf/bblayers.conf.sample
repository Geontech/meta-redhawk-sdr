## conf/bblayers.conf.sample
```bitbake
#
# This file is protected by Copyright. Please refer to the COPYRIGHT file distributed 
# with this source distribution.
#
# This file is part of Geon Technology's meta-redhawk-sdr.
#
# Geon Technology's meta-redhawk-sdr is free software: you can redistribute it and/or 
# modify it under the terms of the GNU Lesser General Public License as published by 
# the Free Software Foundation, either version 3 of the License, or (at your option) 
# any later version.
#
# Geon Technology's meta-redhawk-sdr is distributed in the hope that it will be useful, 
# but WITHOUT ANY WARRANTY; without even the implied warranty of MERCHANTABILITY or 
# FITNESS FOR A PARTICULAR PURPOSE.  See the GNU Lesser General Public License for more
# details.
#
# You should have received a copy of the GNU Lesser General Public License
# along with this program.  If not, see http://www.gnu.org/licenses/.
#


# LAYER_CONF_VERSION is increased each time build/conf/bblayers.conf
# changes incompatibly
LCONF_VERSION = "5"

BBPATH = "${TOPDIR}"
BBFILES ?= ""

BBLAYERS ?= " \
  ##COREBASE##/meta \
  ##COREBASE##/meta-yocto \
  ##COREBASE##/../meta-openembedded/meta-oe \
  ##COREBASE##/../meta-openembedded/meta-networking \
  ##COREBASE##/../meta-openembedded/meta-python \
  ##COREBASE##/../meta-openembedded/meta-filesystems \
  ##COREBASE##/../meta-redhawk-sdr \
  "
```

## conf/layer.conf
```bitbake
#
# This file is protected by Copyright. Please refer to the COPYRIGHT file distributed
# with this source distribution.
#
# This file is part of Geon Technology's meta-redhawk-sdr.
#
# Geon Technology's meta-redhawk-sdr is free software: you can redistribute it and/or
# modify it under the terms of the GNU Lesser General Public License as published by
# the Free Software Foundation, either version 3 of the License, or (at your option)
# any later version.
#
# Geon Technology's meta-redhawk-sdr is distributed in the hope that it will be useful,
# but WITHOUT ANY WARRANTY; without even the implied warranty of MERCHANTABILITY or
# FITNESS FOR A PARTICULAR PURPOSE.  See the GNU Lesser General Public License for more
# details.
#
# You should have received a copy of the GNU Lesser General Public License
# along with this program.  If not, see http://www.gnu.org/licenses/.
#

BBPATH .= ":${LAYERDIR}"
BBFILES += "\
    ${LAYERDIR}/recipes-*/*/*.bb \
    ${LAYERDIR}/recipes-*/*/*.bbappend \
    "

BBFILE_COLLECTIONS += "redhawk-sdr"
BBFILE_PATTERN_redhawk-sdr = "^${LAYERDIR}/"
BBFILE_PRIORITY_redhawk-sdr = "10"
LAYERVERSION_redhawk-sdr = "3"
LAYERSERIES_COMPAT_redhawk-sdr = "thud"
LAYERDEPENDS_redhawk-sdr = "\
    core \
    openembedded-layer \
    networking-layer \
    meta-python \
    "

# #####################################################
# Set this in your local.conf to override the version #
# (if available in this layer).                       #
# #####################################################
REDHAWK_VERSION ?= "2.2.2"
require conf/versions/redhawk.inc

# Utility scripts for REDHAWK
PATH =. "${LAYERDIR}/scripts:"
```
